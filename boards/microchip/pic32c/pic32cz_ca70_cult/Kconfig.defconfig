## boards/microchip/sam/sam_e70_cult/Kconfig.sam_e70_cult
```kconfig
# SPDX-FileCopyrightText: Copyright The Zephyr Project Contributors
# SPDX-License-Identifier: Apache-2.0

config BOARD_SAM_E70_CULT
	select SOC_SAME70Q21B
```

## boards/microchip/sam/sam_e70_cult/board.yml
```yaml
# SPDX-FileCopyrightText: Copyright The Zephyr Project Contributors
# SPDX-License-Identifier: Apache-2.0

board:
  name: sam_e70_cult
  full_name: PIC32CZ CA70 Curiosity Ultra (SAM E70)
  vendor: microchip
  socs:
    - name: same70q21b
```

## drivers/can/Kconfig.mchp
```kconfig
# SPDX-FileCopyrightText: Copyright The Zephyr Project Contributors
# SPDX-License-Identifier: Apache-2.0

config CAN_MCHP_MCAN_G1
	bool "Microchip M_CAN G1 driver"
	default y
	depends on DT_HAS_MICROCHIP_MCAN_G1_ENABLED
	depends on CLOCK_CONTROL
	select CAN_MCAN
	select PINCTRL
	help
	  Enable the Microchip M_CAN G1 CAN FD front end.

config CAN_MCHP_MCAN_G2
	bool "Microchip M_CAN G2 driver"
	default y
	depends on DT_HAS_MICROCHIP_MCAN_G2_ENABLED
	depends on CLOCK_CONTROL
	select CAN_MCAN
	select PINCTRL
	select PM_POLICY_DEVICE_CONSTRAINTS if PM
	help
	  Enable the Microchip M_CAN G2 CAN FD front end.

config CAN_MCHP_MCAN_G2_MRAM_SECTION
	bool
	depends on CAN_MCHP_MCAN_G2
	help
	  Place the M_CAN message RAM in the .can_message_ram section. A SoC whose
	  M_CAN core can only address the first 64 KB of SRAM enables this option
	  and links the section at the start of SRAM.
```

## drivers/can/Kconfig.sam0
```kconfig
# SAM CAN configuration options
# Copyright (c) 2022 Kamil Serwus
# SPDX-License-Identifier: Apache-2.0

config CAN_SAM0
	bool "Atmel SAM0 CAN driver"
	default y
	depends on DT_HAS_ATMEL_SAM0_CAN_ENABLED
	select CAN_MCAN
	select PINCTRL

config CAN_SAM0_MRAM_SECTION
	bool
	depends on CAN_SAM0
	help
	  Place the M_CAN message RAM in the .can_message_ram section. A SoC whose M_CAN core can
	  only address the first 64 KB of SRAM, but which has more SRAM than that, enables this
	  option and links the section at the start of SRAM.

config CAN_SAM0_IDLE_INHIBIT
	bool
	depends on CAN_SAM0
	help
	  Keep the CPU out of the WFI sleep while a controller is started. A SoC where WFI stops
	  the AHB clock of the M_CAN, which then cannot access its message RAM, enables this
	  option and provides soc_cpu_idle_inhibit_get() and soc_cpu_idle_inhibit_put().
```

## drivers/hwinfo/Kconfig.sam_rstc
```kconfig
# Copyright The Zephyr Project Contributors
# SPDX-License-Identifier: Apache-2.0

config HWINFO_SAM_RSTC
	bool "Atmel SAM reset cause"
	default y
	depends on (SOC_FAMILY_ATMEL_SAM && !SOC_SERIES_SAM4L) || SOC_SERIES_PIC32CZ_CA70
	select HWINFO_HAS_DRIVER
	help
	  Enable Atmel SAM reset cause hwinfo driver.
```

## drivers/mspi/Kconfig.sam_qspi
```kconfig
# SPDX-FileCopyrightText: Copyright The Zephyr Project Contributors
# SPDX-License-Identifier: Apache-2.0

config MSPI_SAM_QSPI
	bool "Atmel SAM QSPI controller in serial memory mode"
	default y
	depends on DT_HAS_ATMEL_SAM_QSPI_CONTROLLER_ENABLED
	select PINCTRL
	help
	  MSPI driver for the QSPI controller of the SAM E70/S70/V70/V71 and
	  PIC32CZ CA70/MC70 in serial memory mode: single, dual and quad I/O
	  transfers to one device, for example a NOR flash through the
	  jedec,nor driver. Transfers are polled.
```

## dts/bindings/can/microchip,mcan-g2.yaml
```yaml
# SPDX-FileCopyrightText: Copyright The Zephyr Project Contributors
# SPDX-License-Identifier: Apache-2.0

title: Microchip M_CAN G2 CAN FD controller

description: |
  Microchip M_CAN G2.

  A Bosch M_CAN core with no Microchip wrapper: the M_CAN registers start at
  offset 0 of the peripheral and both M_CAN interrupt lines are combined into
  a single interrupt. The core addresses its message RAM with 16-bit offsets
  from 0x20000000, so the message RAM must be located in the first 64 KB of
  SRAM.

  Supported families: PIC32CX SG.

  Group g2 CAN driver supports following hardware peripherals:
    - module name="CAN" id="U2003" version="3.2.1"

  The CAN module 03723 (can_fd_u2003_v4) of PIC32CK SG/GC and PIC32CZ CA
  has the same register layout plus MRCFG.OFFSET, which moves the 64 KB
  message RAM window. Supporting it requires programming MRCFG.OFFSET.

compatible: "microchip,mcan-g2"

include:
  - name: bosch,m_can-base.yaml
  - name: pinctrl-device.yaml

properties:
  reg:
    required: true

  interrupts:
    required: true

  clocks:
    required: true

  clock-names:
    required: true
    description: |
      Two entries: "mclk", the peripheral bus clock, and "gclk", the generic
      clock feeding the M_CAN core.

  pinctrl-0:
    required: true

  pinctrl-names:
    required: true
```

## dts/bindings/gpio/microchip,pio-g1-gpio.yaml
```yaml
# SPDX-FileCopyrightText: Copyright The Zephyr Project Contributors
# SPDX-License-Identifier: Apache-2.0

title: Microchip PIO GPIO controller (group g1)

description: |
  GPIO controller for one port of the Microchip PIO (group g1). The port
  peripheral clock is enabled at init; it is needed to read inputs and detect
  input changes.

  Group g1 PIO GPIO driver supports following hardware peripherals:
    - module name="PIO" id="11004" version="V"

compatible: "microchip,pio-g1-gpio"

include:
  - name: base.yaml
  - name: gpio-controller.yaml

properties:
  reg:
    required: true

  interrupts:
    required: true

  clocks:
    required: true

  "#gpio-cells":
    const: 2

gpio-cells:
  - pin
  - flags
```

## dts/bindings/hwinfo/atmel,sam-rstc.yaml
```yaml
# Copyright (c) 2022 Basalte bv
# SPDX-License-Identifier: Apache-2.0

description: ATMEL SAM Reset controller

compatible: "atmel,sam-rstc"

include: base.yaml

properties:
  reg:
    required: true

  clocks:
    description: |
      Peripheral clock of the reset controller, enabled at boot. Omit it where
      the reset controller has no PMC clock gate (PIC32CZ CA70).

  user-nrst:
    type: boolean
    description: Allow user reset on external NRST assert.
```

## dts/bindings/i2c/microchip,twihs-g1-i2c.yaml
```yaml
# SPDX-FileCopyrightText: Copyright The Zephyr Project Contributors
# SPDX-License-Identifier: Apache-2.0

title: Microchip TWIHS I2C controller (group g1)

description: |
  Microchip Two-wire Interface High Speed (TWIHS) in I2C controller mode,
  with standard (100 kHz) and fast (400 kHz) speeds.

  Group g1 TWIHS I2C driver supports following hardware peripherals:
    - module name="TWIHS" id="11210" version="Z"

compatible: "microchip,twihs-g1-i2c"

include:
  - name: i2c-controller.yaml
  - name: pinctrl-device.yaml

properties:
  reg:
    required: true

  interrupts:
    required: true

  clocks:
    required: true

  pinctrl-0:
    required: true

  pinctrl-names:
    required: true
```

## dts/bindings/mspi/atmel,sam-qspi-controller.yaml
```yaml
# SPDX-FileCopyrightText: Copyright The Zephyr Project Contributors
# SPDX-License-Identifier: Apache-2.0

description: |
  Atmel SAM QSPI controller in serial memory mode, as found on SAM
  E70/S70/V70/V71 and PIC32CZ CA70/MC70, with an MSPI interface.

  The controller drives one device on its hardware chip select, QCS, in
  single, dual or quad I/O (1-1-1, 1-1-2, 1-2-2, 2-2-2, 1-1-4, 1-4-4 and
  4-4-4), single data rate. Data goes through the serial memory window,
  the second reg entry, which must be mapped as device memory: cached or
  speculative accesses to it would read extra data from the device. For
  example, in the board devicetree:

    memory@80000000 {
      compatible = "zephyr,memory-region";
      reg = <0x80000000 DT_SIZE_M(4)>;
      zephyr,memory-region = "QSPI_MM";
      zephyr,memory-attr = <DT_MEM_ARM(ATTR_MPU_IO)>;
    };

  The SoC node has the "atmel,sam-qspi" compatible (SPI mode); a board
  selects this driver by overriding it:

    &qspi {
      compatible = "atmel,sam-qspi-controller";
      pinctrl-0 = <&qspi_quad>;
      pinctrl-names = "default";
      status = "okay";

      flash@0 {
        compatible = "jedec,nor";
        reg = <0>;
        mspi-max-frequency = <50000000>;
        read-io-mode = "MSPI_IO_MODE_QUAD_1_4_4";
        ...
      };
    };

compatible: "atmel,sam-qspi-controller"

include: [base.yaml, pinctrl-device.yaml, mspi-controller.yaml]

properties:
  reg:
    required: true

  reg-names:
    required: true
    description: |
      "qspi" for the registers, "qspi_mm" for the serial memory window.

  interrupts:
    required: true

  clocks:
    required: true

  pinctrl-0:
    required: true

  pinctrl-names:
    required: true
```
